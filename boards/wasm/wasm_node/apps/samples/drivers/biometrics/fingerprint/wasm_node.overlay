/*
 * SPDX-License-Identifier: Apache-2.0
 *
 * Upstream's biometrics emulator as the fingerprint sensor, as native_sim's
 * overlay has it. This replaces the sample's app.overlay, which puts a real
 * sensor on a second UART, the way a board overlay does on any board.
 */

/ {
	aliases {
		fingerprint = &biometrics_emul;
	};

	biometrics_emul: biometrics-emul {
		compatible = "zephyr,biometrics-emul";
		status = "okay";
	};
};

## dts/bindings/wasm,host-sensor-bridge.yaml
```yaml
# SPDX-License-Identifier: Apache-2.0
description: |
  Lets the host set what the board's emulated sensors measure.

  The sensors themselves are upstream's emulators on upstream's emulated bus,
  and the sensor drivers are the real ones. This node is only the bridge: the
  host queues a reading and raises the interrupt, and the ISR hands it to the
  emulator through the emulated-sensor backend API, as a test would. The
  driver then reads it over the bus as it would read a chip.

compatible: "wasm,host-sensor-bridge"

include: base.yaml

properties:
  sensors:
    type: phandles
    required: true
    description: |
      The emulated sensors to bridge, in the order the host indexes them.

  interrupts:
    required: true
```

## dts/bindings/wasm,host-timer.yaml
```yaml
# SPDX-License-Identifier: Apache-2.0
description: System timer provided by the host through the zephyr_host imports
compatible: "wasm,host-timer"
include: base.yaml
```

## dts/bindings/wasm,host-uart.yaml
```yaml
# SPDX-License-Identifier: Apache-2.0
description: |
  A UART provided by the host through the zephyr_host imports, one of
  several ports.

  Polled, or interrupt-driven with CONFIG_UART_INTERRUPT_DRIVEN. The host
  raises the interrupt when bytes arrive for the board; the driver raises it
  itself while its transmit interrupt is enabled, since the host takes every
  byte at once.

compatible: "wasm,host-uart"

include: [uart-controller.yaml, base.yaml]

properties:
  interrupts:
    required: true
  port:
    type: int
    default: 0
    description: |
      Which of the host's UARTs this is. 0 is the console. 1 is a Bluetooth
      controller's HCI line, whose host end is the host's virtual controller
      (DESIGN.md D8p).
```

## soc/wasm/Kconfig.defconfig
```kconfig
# SPDX-License-Identifier: Apache-2.0

if SOC_NODE

config SYS_CLOCK_HW_CYCLES_PER_SEC
	default 1000000

config NUM_IRQS
	default 16

endif # SOC_NODE
```

## soc/wasm/Kconfig.soc
```kconfig
# SPDX-License-Identifier: Apache-2.0

config SOC_NODE
	bool
	select SOC_FAMILY_WASM
	help
	  A Node.js host acting as the SoC: it provides the zephyr_host
	  imports instead of memory-mapped peripherals.

config SOC
	default "node" if SOC_NODE

config SOC_SERIES
	default "wasm" if SOC_NODE

config SOC_FAMILY
	default "wasm" if SOC_FAMILY_WASM

config SOC_FAMILY_WASM
	bool
```

## arch/wasm/Kconfig
```kconfig
# WebAssembly architecture configuration
# SPDX-License-Identifier: Apache-2.0

config WASM
	bool
	select ARCH_IS_SET
	select ATOMIC_OPERATIONS_BUILTIN
	select USE_SWITCH
	select USE_SWITCH_SUPPORTED
	select ARCH_HAS_CUSTOM_BUSY_WAIT
	select ARCH_HAS_SEMIHOST
	select IRQ_OFFLOAD_NESTED if IRQ_OFFLOAD
	help
	  WebAssembly architecture. The kernel runs freestanding in a single
	  wasm32 linear memory; the host supplies devices as imported
	  functions rather than as memory-mapped registers.

if WASM

menu "WebAssembly Options"

config ARCH
	string
	default "wasm"

# Context switching runs on Binaryen's Asyncify transform for now. Everything
# goes through one internal interface so a stack-switching backend can replace
# it later without touching the rest of the arch.
config WASM_ASYNCIFY
	bool
	default y
	help
	  Use Asyncify to save and restore thread stacks.

config WASM_ASYNCIFY_BUFFER_SIZE
	int "Bytes of each thread stack reserved for the Asyncify buffer"
	default 8192 if MBEDTLS || NET_ZPERF
	default 4096
	help
	  Every thread stack object is split in two: the low part is the C
	  shadow stack, the high part is the Asyncify buffer that holds
	  unwound wasm frames.

	  Spike C measured the buffer needing roughly 88 bytes plus 32 per
	  frame live when the thread yields. Asyncify does not bounds-check
	  this buffer as it writes: overflowing it corrupts whatever follows.
	  The host notices once the thread has suspended and stops the run,
	  naming the buffer, but the damage is done by then, so the default is
	  deliberately generous.

	  A TLS handshake suspends from deeper in the stack than anything
	  else measured: tests/net/socket/tls needed 4160 bytes. So a build
	  with mbedTLS gets twice the usual, and so does one with zperf, whose
	  upload suspends from the shell thread, below a command handler, the
	  shell and the socket layer: a UDP upload needed 4240.

config WASM_STACK_HEADROOM
	int "Bytes of C stack each thread gets beyond the size it asked for"
	default 8192 if DEBUG_OPTIMIZATIONS || NO_OPTIMIZATIONS
	default 0
	help
	  Upstream sizes its thread stacks for native targets. Optimised,
	  wasm code needs no more than that, but built for debugging (-Og, as
	  CONFIG_DEBUG=y does) it keeps far more on the shadow stack.
	  smf_calculator, which asks for CONFIG_DEBUG, gives its own thread
	  1 KB. It ran off the bottom of that into the kernel objects, the log
	  core's buffer and the log sources' names linked below it: first the
	  run went silent, with main's timeout and the shell thread
	  overwritten; with 2048 more it trapped on a corrupted function
	  pointer; with 4096 more it ran, but printed its log source's name as
	  garbage. With 8192 more, and with 16384, an eleven-key session
	  printed the same, correctly.

	  Nothing guards the C stack (DESIGN.md D8), so too little shows up
	  later, somewhere else. The extra is reserved in every stack object,
	  above the size asked for, so the kernel's view of the stack is
	  unchanged, and only a debugging build pays for it.

config WASM_SAFEPOINTS
	bool "Check for pending interrupts at loop back-edges"
	default y
	help
	  Nothing preempts a running wasm function, so without this a thread
	  that never yields cannot be interrupted at all, and time slicing
	  does not work.

	  With it, a post-link pass inserts a call to z_wasm_safepoint at the
	  top of every loop body. The cost is one load and branch per
	  iteration of every loop in the image.

config WASM_SAFEPOINTS_PER_TICK
	int "Safepoints between progress reports to the host"
	default 20000
	depends on WASM_SAFEPOINTS
	help
	  Under virtual time the clock only advances when the kernel idles, so
	  a thread that spins without calling the kernel would freeze it. Every
	  this many safepoints, the guest gives the host a chance to advance
	  time and raise a deadline.

	  Lower is more responsive and slower; higher is the reverse. This is
	  the knob that decides how coarse preemption is for code that never
	  calls into the kernel.

config WASM_RUN_MAX_TIME_MS
	int "Guest time limit for `west build -t run`"
	default 60000
	help
	  Bounds a run started through the build system, which is also how
	  twister drives this board.

config WASM_RUN_REALTIME
	bool "Follow the wall clock for `west build -t run`"
	help
	  Off by default, so runs are reproducible.

config WASM_IRQ_LINES
	int "Number of host interrupt lines"
	default 16
	help
	  Size of the software ISR table. Interrupts arrive cooperatively: the
	  host sets a pending word in linear memory and the kernel notices it
	  at a safepoint.

# Picolibc's default is a malloc arena from the linker symbol _end to the end
# of RAM, and wasm-ld has no linker script to define _end. This is native_sim's
# answer to the same problem: a fixed arena in BSS. A build that chooses the
# minimal libc keeps its own default of none. Sourced before lib/libc, so this default is seen first.
config COMMON_LIBC_MALLOC_ARENA_SIZE
	default 16384 if !MINIMAL_LIBC

# PTHREAD_STACK_MIN is K_KERNEL_STACK_LEN(0), which here is what every stack
# reserves, the Asyncify buffer and any headroom, so the kernel's default of
# 1024 for a dynamically allocated stack makes pthread_create() refuse every
# thread. x86 has the same default for a similar reason. Kconfig cannot add,
# so the sums are spelled out.
config DYNAMIC_THREAD_STACK_SIZE
	default 16384 if WASM_ASYNCIFY_BUFFER_SIZE = 8192 && WASM_STACK_HEADROOM = 8192
	default 12288 if WASM_ASYNCIFY_BUFFER_SIZE = 4096 && WASM_STACK_HEADROOM = 8192
	default WASM_ASYNCIFY_BUFFER_SIZE

endmenu

endif # WASM

config WASM_INSPECT
	bool "Let the host ask about the kernel's threads"
	default y
	select THREAD_MONITOR
	select THREAD_NAME
	select THREAD_STACK_INFO
	help
	  Exports a walk of the kernel's thread list in a shape the host can
	  read, so a page can show which threads exist and which one holds the
	  CPU. The host learns no struct offsets: it asks and is answered.

	  The cost is the three options above, which the kernel would not
	  otherwise carry.

config WASM_INSPECT_STACK_SIZE
	int "Stack for the inspection walk"
	default 2048
	depends on WASM_INSPECT
	help
	  The walk runs on a stack of its own rather than spending the headroom
	  of whichever thread happens to be suspended when the host asks. The
	  host also borrows its top for the records the walk writes, 48 bytes
	  for each of up to 24 threads, so the walk's own stack is what is
	  left below them.
```

## boards/wasm/wasm_node/board.yml
```yaml
# SPDX-License-Identifier: Apache-2.0
board:
  name: wasm_node
  full_name: WebAssembly on a Node.js host
  vendor: wasm
  socs:
    - name: node
```

## drivers/Kconfig
```kconfig
# SPDX-License-Identifier: Apache-2.0
rsource "console/Kconfig"
rsource "serial/Kconfig"
rsource "timer/Kconfig"
rsource "gpio/Kconfig"
rsource "entropy/Kconfig"
rsource "flash/Kconfig"
rsource "display/Kconfig"
rsource "input/Kconfig"
```

## drivers/console/Kconfig
```kconfig
# SPDX-License-Identifier: Apache-2.0

config WASM_HOST_CONSOLE
	bool "Console straight over the zephyr_host console_write import"
	depends on WASM
	depends on !UART_CONSOLE
	default y if !SERIAL
	select CONSOLE_HAS_DRIVER
	help
	  Routes printk through the host without going near a UART. Useful for
	  a build with no serial at all; otherwise UART_CONSOLE over the
	  host UART is the ordinary path and does the same job.
```

## drivers/display/Kconfig
```kconfig
# SPDX-License-Identifier: Apache-2.0

config DISPLAY_WASM_HOST
	bool "Display drawn by the host"
	default y
	depends on DT_HAS_WASM_HOST_DISPLAY_ENABLED
	depends on DISPLAY
	help
	  A display whose framebuffer lives in linear memory and which the host
	  draws: onto a <canvas> in the browser, or into a screenshot under
	  Node. Mirrors native_sim's display_sdl, one layer lower.
```

## drivers/entropy/Kconfig
```kconfig
# SPDX-License-Identifier: Apache-2.0

config ENTROPY_WASM_HOST
	bool "Entropy from the host"
	default y
	depends on DT_HAS_WASM_HOST_ENTROPY_ENABLED
	depends on ENTROPY_GENERATOR
	select ENTROPY_HAS_DRIVER
	help
	  Asks the host for random bytes. Not a real entropy source: the host's
	  default generator is seeded and repeats exactly, because a run of this
	  port has to be reproducible. Only for tests and for samples that want
	  a number rather than a secret.
```

## drivers/ethernet/Kconfig
```kconfig
# SPDX-License-Identifier: Apache-2.0

config ETH_WASM_HOST
	bool "Ethernet to another board, through the host"
	default y
	depends on DT_HAS_WASM_HOST_ETHERNET_ENABLED
	depends on ETH_DRIVER && NET_L2_ETHERNET
	select ENTROPY_GENERATOR
	help
	  An Ethernet interface whose frames go to the host, which relays
	  them to another board: the page's two-board builds, and run.mjs
	  --peer. The node is off on wasm_node; the wasm-ethernet snippet
	  turns it on.
```

## drivers/flash/Kconfig
```kconfig
# SPDX-License-Identifier: Apache-2.0

# In variables because Kconfig splits a function's arguments on commas.
DT_CHOSEN_WASM_FLASH_CONTROLLER := zephyr,flash-controller
DT_COMPAT_WASM_SIM_FLASH := zephyr,sim-flash

config FLASH_WASM_HOST
	bool "Let the host keep the simulated flash between runs"
	default y
	depends on FLASH_SIMULATOR
	depends on $(dt_chosen_has_compat,$(DT_CHOSEN_WASM_FLASH_CONTROLLER),$(DT_COMPAT_WASM_SIM_FLASH))
	help
	  Tells the host where the flash simulator's array is, right after the
	  driver has erased it at boot, so the host can fill it with an image it
	  kept from an earlier run or from before a reboot, and read it back
	  whenever the guest is paused. The guest's view is unchanged: it is
	  still upstream's flash simulator, and a host with no image leaves it
	  erased.
```

## drivers/gpio/Kconfig
```kconfig
# SPDX-License-Identifier: Apache-2.0

config WASM_GPIO_BRIDGE
	bool "Carry the emulated GPIO ports across to the host"
	default y
	depends on DT_HAS_WASM_HOST_GPIO_BRIDGE_ENABLED
	depends on GPIO
	select GPIO_EMUL
	help
	  Reports output changes to the host and pushes the host's input
	  changes back in, so a page can draw the LEDs and press the buttons.
	  The pins themselves are Zephyr's own emulated GPIO controller, so
	  the driver, subsystem and sample code above them is the real thing.

config WASM_GPIO_BRIDGE_INIT_PRIORITY
	int "Init priority of the GPIO bridge"
	default 50
	depends on WASM_GPIO_BRIDGE
	help
	  POST_KERNEL priority. It has to be after the emulated ports, which
	  are POST_KERNEL at GPIO_INIT_PRIORITY (40 by default), and before
	  anything that uses them: gpio-leds and gpio-keys are both
	  POST_KERNEL at 90.
```

## drivers/input/Kconfig
```kconfig
# SPDX-License-Identifier: Apache-2.0

config INPUT_WASM_HOST
	bool "Pointer, touch and keyboard input from the host"
	default y
	depends on DT_HAS_WASM_HOST_INPUT_ENABLED
	depends on INPUT
	help
	  Events the host queues -- a touch on the page's canvas, a key
	  pressed while it has focus -- reported through input_report() from
	  an interrupt, as a touch controller's driver would. Mirrors
	  native_sim's input_sdl_touch.
```

## drivers/sensor/Kconfig
```kconfig
# SPDX-License-Identifier: Apache-2.0

config SENSOR_WASM_BRIDGE
	bool "Let the host set what the emulated sensors measure"
	default y
	depends on DT_HAS_WASM_HOST_SENSOR_BRIDGE_ENABLED
	depends on SENSOR && EMUL
	help
	  Readings the host queues -- a page tilting the board, a scripted
	  run -- handed to the board's emulated sensors through the
	  emulated-sensor backend API, from an interrupt. The sensor drivers
	  then read them over the emulated bus as they would read a chip.
```

## drivers/serial/Kconfig
```kconfig
# SPDX-License-Identifier: Apache-2.0

config UART_WASM_HOST
	bool "UART over the zephyr_host uart imports"
	default y
	depends on DT_HAS_WASM_HOST_UART_ENABLED
	depends on SERIAL
	select SERIAL_HAS_DRIVER
	select SERIAL_SUPPORT_INTERRUPT
	help
	  The host reads and writes a byte at a time. Polled, and with
	  CONFIG_UART_INTERRUPT_DRIVEN interrupt-driven too: the host raises the
	  UART line when bytes arrive, and the driver raises it itself while its
	  transmit interrupt is enabled.
```

## drivers/timer/Kconfig
```kconfig
# SPDX-License-Identifier: Apache-2.0

config WASM_HOST_TIMER
	bool "System timer backed by the zephyr_host clock imports"
	default y
	depends on WASM
	select TICKLESS_CAPABLE
	help
	  Monotonic time and alarms come from the host. Under virtual time the
	  host jumps to the next deadline when the kernel idles, which is what
	  makes runs reproducible.
```

## dts/bindings/wasm,host-console.yaml
```yaml
# SPDX-License-Identifier: Apache-2.0
description: Console provided by the host through the zephyr_host imports
compatible: "wasm,host-console"
include: base.yaml
```

## dts/bindings/wasm,host-display.yaml
```yaml
# SPDX-License-Identifier: Apache-2.0
description: |
  A display the host draws: on the page, a <canvas>.

  The framebuffer is an array in the guest's linear memory, RGB565, which is
  LVGL's default colour depth, so its samples run unmodified. The guest names
  it to the host at init and reports each region it writes; the host reads
  the pixels whenever the guest is not running. Nothing waits on the host.

compatible: "wasm,host-display"

include: display-controller.yaml

properties:
  pixel-format:
    type: int
    required: true
    description: |
      The one pixel format this display takes, stated in devicetree because
      samples read it from here to size their buffers: draw_touch_events, for
      one, assumes ARGB8888 when it is absent.
    enum:
      - 16 # PANEL_PIXEL_FORMAT_RGB_565
```

## dts/bindings/wasm,host-entropy.yaml
```yaml
# SPDX-License-Identifier: Apache-2.0
description: |
  Entropy from the host.

  Not a real entropy source and not meant to be one. The default generator is
  seeded and produces the same sequence every run, because a run of this port
  is required to be reproducible; the host has a flag for real randomness.

compatible: "wasm,host-entropy"

include: base.yaml
```

## dts/bindings/wasm,host-ethernet.yaml
```yaml
# SPDX-License-Identifier: Apache-2.0
description: |
  An Ethernet interface whose wire is the host: frames the board sends go to
  the host, which hands them to another board, and frames from that board
  arrive on the interrupt. On the page the other board runs in another
  Worker; under Node, in the same process.

  Off by default on wasm_node, so that no build grows an interface it did
  not ask for. The wasm-ethernet snippet turns it on.

compatible: "wasm,host-ethernet"

include: [base.yaml, ethernet-controller.yaml]

properties:
  interrupts:
    required: true
```

## dts/bindings/wasm,host-gpio-bridge.yaml
```yaml
# SPDX-License-Identifier: Apache-2.0
description: |
  Carries Zephyr's emulated GPIO ports across to the host.

  The ports themselves are zephyr,gpio-emul, which is upstream and knows about
  pins, direction, pull, edges and callbacks. This node is only the bridge:
  it reports output changes to the host and pushes the host's input changes
  back in, so that a page can draw the LEDs and press the buttons.

compatible: "wasm,host-gpio-bridge"

include: base.yaml

properties:
  ports:
    type: phandles
    required: true
    description: |
      The emulated GPIO ports to bridge, in the order the host indexes them.

  interrupts:
    required: true
```

## dts/bindings/wasm,host-input.yaml
```yaml
# SPDX-License-Identifier: Apache-2.0
description: |
  Pointer, touch and keyboard input from the host, into Zephyr's input
  subsystem.

  On the page, pressing and dragging on the display's canvas is a touch,
  reported as INPUT_ABS_X, INPUT_ABS_Y and INPUT_BTN_TOUCH in display pixels,
  which is what native_sim's input_sdl_touch reports; a key pressed while the
  canvas has focus is an INPUT_EV_KEY with its Linux key code. The host
  queues events and raises the interrupt; the ISR drains them.

compatible: "wasm,host-input"

include: base.yaml

properties:
  interrupts:
    required: true
```
